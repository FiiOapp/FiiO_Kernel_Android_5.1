## drivers/actel_directC/Kconfig
```kconfig
#
# actel fpga jtag configuration
#

config ACTEL_DIRECTC
	tristate "Actel FPGA Jtag Interface"
	help
	  Provides actel fpga jtag functionality for firmware update.
```

## drivers/input/touchscreen/ftall/Kconfig
```kconfig
config TOUCHSCREEN_FT5x_FT6x_SUPPORT
		tristate "ft5x ft6x touchscreen panel support "
		depends on I2C2_RK29 || I2C2_RK30
        default n
```

## drivers/switch/Kconfig
```kconfig
menuconfig SWITCH
	tristate "Switch class support"
	help
	  Say Y here to enable switch class support. This allows
	  monitoring switches by userspace via sysfs and uevent.

if SWITCH

config SWITCH_GPIO
	tristate "GPIO Swith support"
	depends on GENERIC_GPIO
	help
	  Say Y here to enable GPIO based switch support.

config EXTERNAL_SD
        default n
	tristate "external sdcard support"
	help
	  Say Y here to enable external sdcard support.

endif # SWITCH
```

## drivers/ti_sbw/Kconfig
```kconfig
#
# ti sbw jtag configuration
#
menu "Ti SBW interface"
source "drivers/ti_sbw/ti_linux_cortex_m4/Kconfig"
source "drivers/ti_sbw/ti_linux_common/Kconfig"
endmenu
```

## drivers/ti_sbw/ti_linux_common/Kconfig
```kconfig
#
# ti sbw jtag configuration
#

config TI_SBW_JTAG_COMMON
	tristate "Ti SBW Jtag linux common Interface"
    default n
	help
	  Provides ti sbw jtag common functionality for firmware update.
```

## drivers/ti_sbw/ti_linux_cortex_m4/Kconfig
```kconfig
#
# ti sbw jtag configuration
#
config TI_SBW_JTAG_M4
	tristate "Ti SBW Jtag cortex-M4 Interface"
    default n
	help
	  Provides ti sbw jtag functionality for firmware update.
```
